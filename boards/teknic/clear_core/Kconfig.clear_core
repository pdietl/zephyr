## boards/teknic/clear_core/Kconfig.clear_core
```kconfig
# Copyright (c) 2025 Pete Dietl <petedietl@gmail.com>
# SPDX-License-Identifier: Apache-2.0

config BOARD_CLEAR_CORE
	select SOC_SAME53N19A
```

## boards/teknic/clear_core/Kconfig.defconfig
```kconfig
# Teknic ClearCore board configuration
#
# Copyright (c) 2025 Pete Dietl <petedietl@gmail.com>
# SPDX-License-Identifier: Apache-2.0

if BOARD_CLEAR_CORE

if NETWORKING

config NET_L2_ETHERNET
	default y

endif # NETWORKING

source "boards/common/usb/Kconfig.cdc_acm_serial.defconfig"

endif # BOARD_CLEAR_CORE
```

## boards/teknic/clear_core/board.yml
```yaml
board:
  name: clear_core
  full_name: Teknic ClearCore Motion Controller
  vendor: teknic
  socs:
    - name: same53n19a
```

## boards/teknic/clear_core/clear_core_defconfig
```kconfig
CONFIG_USE_DT_CODE_PARTITION=y
CONFIG_HW_STACK_PROTECTION=y
CONFIG_SOC_ATMEL_SAMD5X_OSCULP32K_AS_MAIN=y
CONFIG_ARM_MPU=y

CONFIG_UART_CONSOLE=y
CONFIG_CONSOLE=y
CONFIG_SERIAL=y

CONFIG_SPI=y
```
